## work/blinky/build/Kconfig/arch/Kconfig
```kconfig
# Load Zephyr Arch Kconfig descriptions.
osource "/home/josh/zephyrproject/zephyr/arch/x86/Kconfig"
osource "/home/josh/zephyrproject/zephyr/arch/xtensa/Kconfig"
osource "/home/josh/zephyrproject/zephyr/arch/sparc/Kconfig"
osource "/home/josh/zephyrproject/zephyr/arch/riscv/Kconfig"
osource "/home/josh/zephyrproject/zephyr/arch/posix/Kconfig"
osource "/home/josh/zephyrproject/zephyr/arch/nios2/Kconfig"
osource "/home/josh/zephyrproject/zephyr/arch/mips/Kconfig"
osource "/home/josh/zephyrproject/zephyr/arch/arm64/Kconfig"
osource "/home/josh/zephyrproject/zephyr/arch/arm/Kconfig"
osource "/home/josh/zephyrproject/zephyr/arch/arc/Kconfig"
```

## work/blinky/build/Kconfig/boards/Kconfig
```kconfig
# Load Zephyr board Kconfig descriptions.
osource "/home/josh/zephyrproject/zephyr/boards/beagle/beagley_ai/Kconfig"
```

## work/blinky/build/Kconfig/boards/Kconfig.beagley_ai
```kconfig
# Load board Kconfig descriptions.
osource "/home/josh/zephyrproject/zephyr/boards/beagle/beagley_ai/Kconfig.beagley_ai"
```

## work/blinky/build/Kconfig/boards/Kconfig.defconfig
```kconfig
# Load Zephyr board defconfig descriptions.
osource "/home/josh/zephyrproject/zephyr/boards/beagle/beagley_ai/Kconfig.defconfig"
```

## work/blinky/build/Kconfig/boards/Kconfig.sysbuild
```kconfig
# Load Sysbuild board Kconfig descriptions.
osource "/home/josh/zephyrproject/zephyr/boards/beagle/beagley_ai/Kconfig.sysbuild"
```
